## examples/Bluetooth_HID_remapper/sdkconfig.defaults.esp32s3
```kconfig
CONFIG_BT_ENABLED=y
CONFIG_BT_BLUEDROID_ENABLED=y
CONFIG_BT_BLE_ENABLED=y
CONFIG_BT_BLE_42_FEATURES_SUPPORTED=y
CONFIG_TINYUSB_HID_COUNT=1
CONFIG_FREERTOS_HZ=1000
CONFIG_SOC_USB_OTG_SUPPORTED=y
CONFIG_TINYUSB_HTD_ENABLED=y
```
